#include "oled_i2c.h"
#include <stdlib.h>
#include <string.h>
#include "i2c.h"
const uint8_t ASCII[][16] = 
{
{0x00,0x00,0x00,0x00,0x00,0x00,0x00,0x00,0x00,0x00,0x00,0x00,0x00,0x00,0x00,0x00},/*" ",0*/
{0x00,0x00,0x00,0xF8,0x00,0x00,0x00,0x00,0x00,0x00,0x00,0x33,0x00,0x00,0x00,0x00},/*"!",1*/
{0x00,0x10,0x0C,0x02,0x10,0x0C,0x02,0x00,0x00,0x00,0x00,0x00,0x00,0x00,0x00,0x00},/*""",2*/
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{0x00,0x02,0x01,0x02,0x02,0x04,0x02,0x00,0x00,0x00,0x00,0x00,0x00,0x00,0x00,0x00},/*"~",94*/
};



I2C_HandleTypeDef * g_OLED_i2c = &hi2c2;
__IO uint8_t i2c_dma_status = 0;

void OLED_command( uint8_t cmd )
{	
	HAL_I2C_Mem_Write( g_OLED_i2c, OLED_ADDRESS, OLED_COMMAND_REG, I2C_MEMADD_SIZE_8BIT, (uint8_t *) &cmd , 1 , 100) ;
}

void OLED_data( uint8_t data , uint8_t inv )
{
	if (inv == 0 )
	{
		HAL_I2C_Mem_Write( g_OLED_i2c, OLED_ADDRESS, OLED_DATA_REG, I2C_MEMADD_SIZE_8BIT, (uint8_t *) &data , 1 , 100 ) ;
	}
	else
	{
		data = ~ data ;
		HAL_I2C_Mem_Write( g_OLED_i2c, OLED_ADDRESS, OLED_DATA_REG, I2C_MEMADD_SIZE_8BIT, (uint8_t *) &data , 1 , 100 ) ;
	}
}

void OLED_address( uint8_t page , uint8_t col )
{
	uint8_t t ;
	t = 0xb0 + page ;
	OLED_command( t );
	t = (( col >> 4 ) & 0x0f ) + 0x10 ;
	OLED_command( t );
	t = col & 0x0f  ;
	OLED_command( t );
}

void OLED_init( void )
{
    OLED_command(0xae); 
 
    OLED_command(0xd5);	 
    OLED_command(0x80); 
 
    OLED_command(0xa8);	 
    OLED_command(0x1f); 
 
    OLED_command(0xd3); 
    OLED_command(0x00); 
 
    OLED_command(0x40);	
 
    OLED_command(0x8d);	
    OLED_command(0x14);
 
    OLED_command(0x20);	
    OLED_command(0x02);
 
    OLED_command(0xc8); 
    OLED_command(0xa1); 
 
    OLED_command(0xda); 
//    OLED_command(0x12);
    OLED_command(0x02);
 
    OLED_command(0x81);
    OLED_command(0xcf);
 
    OLED_command(0xd9);
    OLED_command(0xf1);
 
    OLED_command(0xdb); 
    OLED_command(0x40);
 
    OLED_command(0xaf); 
}


void OLED_clear( void )
{
	uint8_t i , j ;
	for ( i = 0  ; i < 4 ; i++)
	{
		OLED_address( i , 0 );
		for ( j = 0 ; j < 128 ; j++ )
		{ 
			OLED_data( 0x00 , 0 ) ;
		}
	}
}
/*
row = 0 ~ 1
col = 0 ~ 127
*/
void OLED_ShowAscii( uint8_t row , uint8_t col , uint8_t * data , uint8_t length , uint8_t inv )
{
	uint8_t i, j ,pos ;
	const uint8_t * pchar ;
	if ( row > 1 || col > 31 ) return ;
	for ( i = 0 ; i < length ; i++ )
	{
		pos = data[i] - ' ';
		if ( pos > 94 ) pos = 0 ;
		pchar = ASCII[ pos ];
	  OLED_address( row*2 , (col+i)*8 );
		for ( j = 0 ; j < 8 ; j++ )
		{
		  OLED_data( pchar[j] , inv ) ;
		}
	  OLED_address( row*2+1 , (col+i)*8 );
		for ( j = 0 ; j < 8 ; j++ )
		{
		  OLED_data( pchar[j + 8] ,inv ) ;
		}		
	}
}

uint8_t g_i2c_top_cmd[3];
uint8_t g_i2c_low_cmd[3];
uint8_t g_i2c_top_buf[128];
uint8_t g_i2c_low_buf[128];

void OLED_ShowAscii_2_Buf(uint8_t row , uint8_t col , uint8_t * data , uint8_t length , uint8_t inv)
{
	uint8_t t , pos, index = 0;
	uint16_t i, j;
	const uint8_t * pchar ;
	
	t = 0xb0 + row*2 ;
	g_i2c_top_cmd[index++] = t;
	t = (( col >> 1 ) & 0x0f ) + 0x10 ;
	g_i2c_top_cmd[index++] = t;
	t = ( col << 3 ) & 0x0f  ;
	g_i2c_top_cmd[index++] = t;
	
	index = 0;
	
	if ( row > 1 || col > 31 ) return ;
	
	for( i = 0 ; i < length ; i++ )
	{
		pos = data[i] - ' ';
		if ( pos > 94 ) pos = 0 ;
		pchar = ASCII[ pos ];
		for ( j = 0 ; j < 8 ; j++ )
		{
			g_i2c_top_buf[index++] = (inv == 0) ? pchar[j] : ~pchar[j];
		}
	}
	
	index = 0;
	
	t = 0xb0 + row*2+1 ;
	g_i2c_low_cmd[index++] = t;
	t = (( col >> 1 ) & 0x0f ) + 0x10 ;
	g_i2c_low_cmd[index++] = t;
	t = ( col << 3 ) & 0x0f  ;
	g_i2c_low_cmd[index++] = t;
	
	index = 0;
	
	for( i = 0 ; i < length ; i++ )
	{
		pos = data[i] - ' ';
		if ( pos > 94 ) pos = 0 ;
		pchar = ASCII[ pos ];
		for ( j = 0 ; j < 8 ; j++ )
		{
			g_i2c_low_buf[index++] = (inv == 0) ? pchar[j + 8] : ~pchar[j + 8];
		}
	}
	
}

void OLED_Notice( void )
{
	uint8_t data[2][17] = { {"Remove OLED     "} ,
								          {"Connect DotMatri"} } ;
	OLED_ShowAscii( 0,0,data[0] , 16 ,0  );
	OLED_ShowAscii( 1,0,data[1] , 16 ,0  );
	
}

void OLED_all_on( void )
{
	uint8_t data[3][17] = { {"Init QMI8610.  "} ,
								          {"Init QMI8610.. "} ,
								          {"Init QMI8610..."} 
	                    } ;
  uint8_t i = 0 ;
	
	while ( 1)
	{
	  OLED_ShowAscii( 0,0,data[i] ,strlen(data[i]) ,1  );
		HAL_Delay(500);
		if ( i < 2 )i++;
		else i = 0;
	}
}

void OLED_Debug(uint8_t *data, uint8_t row , uint8_t col)
{
	uint8_t buf[16];
	uint8_t len;
	len = strlen(data);
	if(len < 16)
	{
		memset(buf, ' ', sizeof(buf));
		strncpy(buf, data, len);
		OLED_ShowAscii_2_Buf(row, col, buf, 16, 0);
		i2c_dma_status = TOPCMD_TRANS;
		HAL_I2C_Mem_Write_DMA( g_OLED_i2c, OLED_ADDRESS, OLED_COMMAND_REG, I2C_MEMADD_SIZE_8BIT, g_i2c_top_cmd , 3) ;
	}
	else
	{
		OLED_ShowAscii_2_Buf(row, col, data, 16, 0);
		i2c_dma_status = TOPCMD_TRANS;
		HAL_I2C_Mem_Write_DMA( g_OLED_i2c, OLED_ADDRESS, OLED_COMMAND_REG, I2C_MEMADD_SIZE_8BIT, g_i2c_top_cmd , 3) ;
	}
}

void HAL_I2C_MemTxCpltCallback(I2C_HandleTypeDef *hi2c)
{
	switch(i2c_dma_status)
	{
		case TOPCMD_TRANS:
			i2c_dma_status = TOP_HALF_TRANS;
		  HAL_I2C_Mem_Write_DMA( g_OLED_i2c, OLED_ADDRESS, OLED_DATA_REG, I2C_MEMADD_SIZE_8BIT,  g_i2c_top_buf , 128 ) ;
			break;
		case TOP_HALF_TRANS:
			i2c_dma_status = LOWCMD_TRANS;
			HAL_I2C_Mem_Write_DMA( g_OLED_i2c, OLED_ADDRESS, OLED_COMMAND_REG, I2C_MEMADD_SIZE_8BIT, g_i2c_low_cmd , 3) ;
			break;
		case LOWCMD_TRANS:
			i2c_dma_status = LOW_HALF_TRANS;
		  HAL_I2C_Mem_Write_DMA( g_OLED_i2c, OLED_ADDRESS, OLED_DATA_REG, I2C_MEMADD_SIZE_8BIT,  g_i2c_low_buf , 128 ) ;
		break;
		case LOW_HALF_TRANS:
			i2c_dma_status = 0;
		break;
		default:
			break;
	}
}
